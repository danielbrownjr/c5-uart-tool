## main/Kconfig.projbuild
```kconfig
menu "C5 UART capture"
    choice C5_BOARD
        prompt "Target board"
        default C5_BOARD_WAVESHARE
        help
            Choose the physical board. Profiles have different flash geometry.
        config C5_BOARD_WAVESHARE
            bool "Waveshare ESP32-C5-WIFI6-KIT-NXRX (32 MB)"
        config C5_BOARD_CYD
            bool "RockBase NM-CYD-C5 (16 MB LCD)"
    endchoice

    config C5_UART_RX_GPIO
        int "UART1 receive-only GPIO (verify board wiring before connecting)"
        range 4 4
        default 4
        help
            Both documented target profiles expose UART1 capture on GPIO4.
            Confirm actual board identity and connector orientation.

    config C5_UART_BAUD
        int "UART receive baud rate"
        range 1200 2000000
        default 115200
endmenu
```

## sdkconfig.defaults
```kconfig
CONFIG_IDF_TARGET="esp32c5"
CONFIG_ESP_CONSOLE_NONE=y
CONFIG_ESP_CONSOLE_SECONDARY_NONE=y
CONFIG_LOG_DEFAULT_LEVEL_NONE=y
CONFIG_ESPTOOLPY_FLASHSIZE_32MB=y
CONFIG_ESPTOOLPY_FLASHMODE_DIO=y
CONFIG_ESPTOOLPY_FLASHFREQ_80M=y
CONFIG_PARTITION_TABLE_SINGLE_APP=y
CONFIG_C5_UART_RX_GPIO=4
```
